## conf/distro/yocpi.conf
```bitbake
DISTRO = "yocpi"
DISTRO_NAME = "Yocpi"
DISTRO_VERSION = "1.0"
TCLIBC = "glibc"

MAINTAINER = "Joshua John <joshuajohnv15@gmail.com>"

LICENSE_FLAGS_ACCEPTED = "synaptics-killswitch"

DISTRO_FEATURES = "ipv4 ipv6 overlayfs systemd usbgadget usbhost usrmerge wifi"

PACKAGE_CLASSES ?= "package_ipk"

VIRTUAL-RUNTIME_init_manager = "systemd"
VIRTUAL-RUNTIME_initscripts = "systemd-compat-units"
VIRTUAL-RUNTIME_login_manager = "shadow-base"
VIRTUAL-RUNTIME_dev_manager = "systemd"
VIRTUAL-RUNTIME_syslog = ""
VIRTUAL-RUNTIME_base-utils-syslog = ""

INIT_MANAGER = "${VIRTUAL-RUNTIME_init_manager}"

ROOT_HOME = "/root"

ENABLE_UART = "1"

require conf/distro/include/security_flags.inc
```

## conf/layer.conf
```bitbake
# We have a conf and classes directory, add to BBPATH
BBPATH .= ":${LAYERDIR}"

# We have recipes-* directories, add to BBFILES
BBFILES += "${LAYERDIR}/recipes-*/*/*.bb \
            ${LAYERDIR}/recipes-*/*/*.bbappend"

BBFILE_COLLECTIONS += "meta-yocpi"
BBFILE_PATTERN_meta-yocpi = "^${LAYERDIR}/"
BBFILE_PRIORITY_meta-yocpi = "10"

LAYERSERIES_COMPAT_meta-yocpi = "scarthgap"
LAYERDEPENDS_meta-yocpi = "core"
```
